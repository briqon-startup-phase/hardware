## main/Kconfig.projbuild
```kconfig
menu "BRIQON"
config BRIQON_DEMO
    bool "Wokwi demo profile (fault injection, disposable MQTT)"
    default y
config BRIQON_WIFI_SSID
    string "Wi-Fi SSID"
    default "Wokwi-GUEST"
config BRIQON_WIFI_PASSWORD
    string "Wi-Fi password"
    default ""
config BRIQON_BROKER_URI
    string "MQTT URI"
    default "mqtt://broker.emqx.io:1883"
config BRIQON_MQTT_USERNAME
    string "MQTT username"
    default ""
config BRIQON_MQTT_PASSWORD
    string "MQTT password"
    default ""
config BRIQON_DEVICE_ID
    string "Device ID (empty = MAC-derived)"
    default ""
config BRIQON_ENVIRONMENT
    string "Topic environment"
    default "demo"
config BRIQON_CONTROL_ENABLED
    bool "Permit explicit relay commands"
    default y if BRIQON_DEMO
    default n
config BRIQON_RELAY_ACTIVE_LOW
    bool "Relay input active low (Wokwi npn contact behavior)"
    default y
endmenu
```

## sdkconfig.defaults
```kconfig
CONFIG_IDF_TARGET="esp32s3"
# CONFIG_FREERTOS_UNICORE is not set
CONFIG_FREERTOS_HZ=1000
CONFIG_ESPTOOLPY_FLASHSIZE_8MB=y
CONFIG_PARTITION_TABLE_CUSTOM=y
CONFIG_PARTITION_TABLE_CUSTOM_FILENAME="partitions.csv"
CONFIG_ESP_MAIN_TASK_STACK_SIZE=8192
CONFIG_ESP_CONSOLE_UART_DEFAULT=y
CONFIG_ESP_CONSOLE_UART_BAUDRATE=115200
CONFIG_ESP_TASK_WDT_EN=y
CONFIG_ESP_TASK_WDT_INIT=y
CONFIG_ESP_TASK_WDT_PANIC=y
CONFIG_ESP_TASK_WDT_TIMEOUT_S=20
CONFIG_MBEDTLS_CERTIFICATE_BUNDLE=y
CONFIG_MQTT_OUTBOX_EXPIRED_TIMEOUT_MS=30000
CONFIG_LOG_DEFAULT_LEVEL_INFO=y
```

## sdkconfig.defaults.hardware
```kconfig
# CONFIG_BRIQON_DEMO is not set
CONFIG_BRIQON_BROKER_URI="mqtts://replace-me.example.com:8883"
CONFIG_BRIQON_WIFI_SSID="SET_IN_MENUCONFIG"
CONFIG_BRIQON_CONTROL_ENABLED=n
```

## sdkconfig.defaults.wokwi
```kconfig
CONFIG_BRIQON_DEMO=y
CONFIG_BRIQON_WIFI_SSID="Wokwi-GUEST"
CONFIG_BRIQON_WIFI_PASSWORD=""
CONFIG_BRIQON_BROKER_URI="mqtt://broker.emqx.io:1883"
```
